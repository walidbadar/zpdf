## CMakeLists.txt
```
# Copyright (c) 2026 Muhammad Waleed Badar
# SPDX-License-Identifier: GPL-3.0-only

cmake_minimum_required(VERSION 3.20.0)

find_package(Zephyr REQUIRED HINTS $ENV{ZEPHYR_BASE})
project(zpdf_reader LANGUAGES C)

target_sources(app PRIVATE
  src/main.c
  src/ui.c
  src/worker.c
)

# Where the documents come from: the FAT file system (SD card) on hardware,
# files of the host named on the command line on native_sim.
target_sources_ifdef(CONFIG_FILE_SYSTEM app PRIVATE src/storage_fs.c)
target_sources_ifdef(CONFIG_ZPDF_APP_SD_TUNING app PRIVATE src/sd_tuning.c)
target_sources_ifdef(CONFIG_BOARD_NATIVE_SIM app PRIVATE src/storage_host.c src/screenshot_host.c)
```

## Kconfig
```
# Copyright (c) 2026 Muhammad Waleed Badar
# SPDX-License-Identifier: GPL-3.0-only

mainmenu "zpdf reader"

config ZPDF_APP_MAX_FILE_SIZE
	int "Largest document that is opened (bytes)"
	default 6291456
	help
	  Documents are read into RAM as a whole; on the ESP32-S3 that is the
	  8 MB PSRAM, which also holds the decoded streams.

config ZPDF_APP_MOUNT_POINT
	string "Mount point of the document storage"
	default "/SD:"
	depends on FILE_SYSTEM

config ZPDF_APP_DISK_NAME
	string "Disk the storage is mounted from"
	default "SD"
	depends on FILE_SYSTEM

config ZPDF_APP_MAX_FILES
	int "Maximum number of documents listed"
	default 64

config ZPDF_APP_AUTO_OPEN
	bool "Open the first document at boot"
	help
	  Skips the document list when the storage holds at least one PDF:
	  useful for kiosk-like use and for measuring on hardware.

config ZPDF_APP_SD_TUNING
	bool "Tune the ESP32-S3 SD slot (drive strength, input delay phase)"
	default y if SOC_SERIES_ESP32S3 && SDHC
	depends on SOC_SERIES_ESP32S3

config ZPDF_APP_SD_DRIVE_STRENGTH
	int "Pad drive strength of the SD pins (0 weakest .. 3 strongest, -1 leave)"
	default 3
	range -1 3
	depends on ZPDF_APP_SD_TUNING

config ZPDF_APP_SD_DIN_PHASE
	int "SDMMC host input delay phase (0 .. 3)"
	default 0
	range 0 3
	depends on ZPDF_APP_SD_TUNING

config ZPDF_APP_RENDER_STACK_SIZE
	int "Stack of the render/extract worker thread"
	default 32768

config ZPDF_APP_RENDER_PRIORITY
	int "Priority of the render worker thread (below the UI and the input thread)"
	default 13

config ZPDF_APP_MAX_ZOOM_PCT
	int "Largest page zoom in percent of fit-to-width"
	default 300
	help
	  Pages are rendered in tiles of twice the viewport size, so the cost
	  of a zoom level is bounded; the renderer's clip and soft masks are
	  tile-sized too.

source "Kconfig.zephyr"
```

## sample.yaml
```
# Copyright (c) 2026 Muhammad Waleed Badar
# SPDX-License-Identifier: GPL-3.0-only

sample:
  name: zpdf reader
  description: PDF reader with LVGL user interface
common:
  build_only: true
  tags:
    - zpdf
    - display
tests:
  app.zpdf.reader:
    platform_allow:
      - uedx32480035e_wb_a/esp32s3/procpu
      - native_sim/native/64
    integration_platforms:
      - native_sim/native/64
```

## prj.conf
```kconfig
# Copyright (c) 2026 Muhammad Waleed Badar
# SPDX-License-Identifier: GPL-3.0-only

# --- PDF library -----------------------------------------------------------
CONFIG_ZPDF=y
CONFIG_ZPDF_LOG_LEVEL=2

# --- Kernel ----------------------------------------------------------------
# The main thread only runs LVGL and the UI; parsing and rendering run on
# the worker thread (CONFIG_ZPDF_APP_RENDER_STACK_SIZE).
CONFIG_MAIN_STACK_SIZE=16384
CONFIG_HEAP_MEM_POOL_SIZE=32768
CONFIG_LOG=y
CONFIG_LOG_DEFAULT_LEVEL=3
CONFIG_FPU=y
CONFIG_SPEED_OPTIMIZATIONS=y

# --- Display and touch (LVGL) ---------------------------------------------
CONFIG_DISPLAY=y
CONFIG_INPUT=y
# Touch events are dispatched by the input thread, which by default has the
# lowest priority and would starve behind the render worker: run it above
# the worker, and keep room for a burst of move events.
CONFIG_INPUT_THREAD_PRIORITY_OVERRIDE=y
CONFIG_INPUT_THREAD_PRIORITY=5
CONFIG_INPUT_QUEUE_MAX_MSGS=64
CONFIG_LV_Z_POINTER_INPUT_MSGQ_COUNT=64
CONFIG_LVGL=y
CONFIG_LV_Z_POINTER_INPUT=y
# Widgets and label text; rendered pages are our own buffers in PSRAM
CONFIG_LV_Z_MEM_POOL_SIZE=65536
CONFIG_LV_Z_VDB_SIZE=12
CONFIG_LV_Z_DOUBLE_VDB=y
CONFIG_LV_USE_LABEL=y
CONFIG_LV_USE_BUTTON=y
CONFIG_LV_USE_IMAGE=y
CONFIG_LV_USE_FLEX=y
CONFIG_LV_FONT_MONTSERRAT_12=y
CONFIG_LV_FONT_MONTSERRAT_14=y
CONFIG_LV_FONT_MONTSERRAT_16=y
CONFIG_LV_FONT_MONTSERRAT_18=y
CONFIG_LV_FONT_DEFAULT_MONTSERRAT_14=y
```

## boards/native_sim_native_64.conf
```kconfig
# Copyright (c) 2026 Muhammad Waleed Badar
# SPDX-License-Identifier: GPL-3.0-only
#
# native_sim/native/64: the SDL window stands in for the display, the mouse
# for the touch screen. Documents are host files given with --pdf=<path>.

CONFIG_LV_COLOR_DEPTH_32=y

# Documents are read into the kernel heap on the host
CONFIG_HEAP_MEM_POOL_SIZE=67108864

CONFIG_LOG_BACKEND_NATIVE_POSIX=y
CONFIG_LV_USE_SNAPSHOT=y

# Room for lv_snapshot_take() of the whole screen (--shot)
CONFIG_LV_Z_MEM_POOL_SIZE=4194304
```

## boards/uedx32480035e_wb_a_esp32s3_procpu.conf
```kconfig
# Copyright (c) 2026 Muhammad Waleed Badar
# SPDX-License-Identifier: GPL-3.0-only

# --- Speed ----------------------------------------------------------------
# Largest caches the ESP32-S3 offers: code runs from flash and every page
# buffer lives in PSRAM, both go through these caches. 64-byte data lines
# suit the renderer's sequential access to tiles and masks.
CONFIG_ESP32S3_INSTRUCTION_CACHE_32KB=y
CONFIG_ESP32S3_INSTRUCTION_CACHE_8WAYS=y
CONFIG_ESP32S3_INSTRUCTION_CACHE_LINE_32B=y
CONFIG_ESP32S3_INSTRUCTION_CACHE_WRAP=y
CONFIG_ESP32S3_DATA_CACHE_64KB=y
CONFIG_ESP32S3_DATA_CACHE_8WAYS=y
CONFIG_ESP32S3_DATA_CACHE_LINE_64B=y
CONFIG_ESP32S3_DATA_CACHE_WRAP=y
# Octal PSRAM and flash at 80 MHz, flash in quad I/O mode
CONFIG_SPIRAM_SPEED_80M=y
CONFIG_ESPTOOLPY_FLASHFREQ_80M=y
CONFIG_ESPTOOLPY_FLASHMODE_QIO=y
# -O3 on top of CONFIG_SPEED_OPTIMIZATIONS (prj.conf); flash has room
CONFIG_COMPILER_OPT="-O3"

# The document and everything decoded from it live in the 8 MB octal PSRAM
CONFIG_ESP_SPIRAM=y
CONFIG_ESP_SPIRAM_HEAP_SIZE=8126464

# SD card (4-bit SDMMC) with FAT; long names so real file names show
CONFIG_DISK_ACCESS=y
CONFIG_SDHC=y
CONFIG_SDMMC_STACK=y
CONFIG_DISK_DRIVER_SDMMC=y
CONFIG_FILE_SYSTEM=y
CONFIG_FAT_FILESYSTEM_ELM=y
CONFIG_FS_FATFS_LFN=y
CONFIG_FS_FATFS_MAX_LFN=255
CONFIG_FS_FATFS_EXFAT=y
# A card with an unknown file system is reported, not formatted
CONFIG_FS_FATFS_MOUNT_MKFS=n

# Render the next frame while the previous one goes out over SPI
CONFIG_LV_Z_FLUSH_THREAD=y

# Pages are rendered in tiles of twice the viewport, so 300 % costs about
# 1.7 MB for the tile plus the renderer's masks
CONFIG_ZPDF_APP_MAX_ZOOM_PCT=300
```

## boards/native_sim_native_64.overlay
```dts
/*
 * Copyright (c) 2026 Muhammad Waleed Badar
 * SPDX-License-Identifier: GPL-3.0-only
 *
 * Same geometry as the VIEWE board in landscape.
 */
&sdl_dc {
	width = <480>;
	height = <320>;
};
```

## boards/uedx32480035e_wb_a_esp32s3_procpu.overlay
```dts
/*
 * Copyright (c) 2026 Muhammad Waleed Badar
 * SPDX-License-Identifier: GPL-3.0-only
 *
 * VIEWE UEDX32480035E-WB-A in landscape (480x320) for reading.
 *
 * MADCTL: MV (0x20) exchanges rows and columns, BGR (0x08) is the colour
 * order of the panel. The board's portrait value is 0x48 (MX | BGR). If the
 * picture is upside down for the way the board is mounted, use 0xe8
 * (MY | MX | MV | BGR) and "inverted-y" instead of "inverted-x" for touch.
 */
&st7796s {
	width = <480>;
	height = <320>;
	pgc = [f0 06 0b 07 06 05 2e 33 47 3a 17 16 2e 31];
	ngc = [f0 09 0d 09 08 23 2e 33 46 38 13 13 2c 32];
	madctl = <0x28>;
};

/*
 * The touch controller keeps reporting in the panel's own 320x480 space.
 * Landscape x is the panel's y, and landscape y runs against the panel's x.
 */
&chsc6x {
	screen-width = <320>;
	screen-height = <480>;
	inverted-x;
	swapped-x-y;
};

/*
 * SD card. The slot is routed through the GPIO matrix; with the 4-bit bus
 * the data lines only transfer reliably in default speed mode (measured:
 * reads fail with -EIO at 40 and 52 MHz, work at 25 MHz; 1-bit works up to
 * 52 MHz but is slower overall).
 */
&sdhc0 {
	bus-width = <4>;
	max-bus-freq = <25000000>;
};
```

## src/main.c
```c
/*
 * Copyright (c) 2026 Muhammad Waleed Badar
 * SPDX-License-Identifier: GPL-3.0-only
 *
 * zpdf reader: PDF documents from the SD card on a 480x320 touch display.
 */
#include "storage.h"
#include "ui.h"
#include "worker.h"
#include "screenshot_host.h"
#include <zephyr/kernel.h>
#include <zephyr/device.h>
#include <zephyr/drivers/display.h>
#include <zephyr/input/input.h>
#include <zephyr/logging/log.h>
#include <lvgl.h>

LOG_MODULE_REGISTER(zpdf_app, LOG_LEVEL_INF);

#if DT_HAS_COMPAT_STATUS_OKAY(gpio_keys)
/* The BOOT button turns the page (held together with touch, it goes back). */
static void button_cb(struct input_event *evt, void *user_data)
{
	ARG_UNUSED(user_data);
	if (evt->type == INPUT_EV_KEY && evt->code == INPUT_KEY_0 && evt->value == 1) {
		ui_request_next_page();
	}
}

INPUT_CALLBACK_DEFINE(NULL, button_cb, NULL);
#endif

int main(void)
{
	const struct device *display = DEVICE_DT_GET(DT_CHOSEN(zephyr_display));

	if (!device_is_ready(display)) {
		LOG_ERR("display not ready");
		return 0;
	}
#if defined(CONFIG_ZPDF_APP_SD_TUNING)
	extern void sd_tuning_apply(void);

	sd_tuning_apply();
#endif
	int rc = storage_init();

	if (rc != 0) {
		LOG_WRN("storage unavailable (%d)", rc);
	}
	worker_init();
	ui_init();
	display_blanking_off(display);
	LOG_INF("zpdf reader ready");

	for (;;) {
		ui_poll();
		screenshot_poll();
		uint32_t next = lv_timer_handler();

		k_msleep(CLAMP(next, 1, 20));
	}
	return 0;
}
```

## src/screenshot_host.c
```c
/*
 * Copyright (c) 2026 Muhammad Waleed Badar
 * SPDX-License-Identifier: GPL-3.0-only
 *
 * native_sim only: --shot=<file.ppm> writes the screen a moment after boot
 * (and after --open showed a page), for documentation and visual checks.
 * --page=<n>, --fit, --zoom=<pct> and --text choose what is shown of the
 * opened document.
 */
#include "screenshot_host.h"
#include "ui.h"
#include <zephyr/kernel.h>
#include <lvgl.h>
#include <posix_native_task.h>
#include <cmdline.h>
#include <stdio.h>
#include <stdint.h>
#include <zephyr/sys/printk.h>

static char *shot_path;
static unsigned int shot_delay_ms;
static unsigned int zoom_pct;
static unsigned int page_no;
static bool fit_page;
static bool text_view;
static bool done, zoomed;

static void add_options(void)
{
	static struct args_struct_t options[] = {
		{
			.option = "shot",
			.name = "file.ppm",
			.type = 's',
			.dest = (void *)&shot_path,
			.descript = "Write a screenshot (binary PPM) and keep running",
		},
		{
			.option = "page",
			.name = "n",
			.type = 'u',
			.dest = (void *)&page_no,
			.descript = "Turn to this page (1-based) of the opened document before the screenshot",
		},
		{
			.option = "zoom",
			.name = "pct",
			.type = 'u',
			.dest = (void *)&zoom_pct,
			.descript = "Zoom the opened page to this percentage before the screenshot",
		},
		{
			.is_switch = true,
			.option = "fit",
			.type = 'b',
			.dest = (void *)&fit_page,
			.descript = "Fit the opened page to the view before the screenshot",
		},
		{
			.is_switch = true,
			.option = "text",
			.type = 'b',
			.dest = (void *)&text_view,
			.descript = "Show the text view of the opened page before the screenshot",
		},
		{
			.option = "shot-delay",
			.name = "ms",
			.type = 'u',
			.dest = (void *)&shot_delay_ms,
			.descript = "Delay before the screenshot (default 1500 ms)",
		},
		ARG_TABLE_ENDMARKER,
	};

	native_add_command_line_opts(options);
}

NATIVE_TASK(add_options, PRE_BOOT_1, 10);

void screenshot_poll(void)
{
	static bool announced;

	if (!announced) {
		announced = true;
		/* Numeric options that were not given are left at UINT32_MAX */
		if (shot_delay_ms == UINT32_MAX) {
			shot_delay_ms = 1500;
		}
		if (zoom_pct == UINT32_MAX) {
			zoom_pct = 0;
		}
		if (page_no == UINT32_MAX || page_no == 0) {
			page_no = 1;
		}
		printk("screenshot: option %s, delay %u ms\n", shot_path ? shot_path : "(none)", shot_delay_ms);
	}
	/* One page turn per poll: the request is consumed by the next ui_poll() */
	if (page_no > 1 && k_uptime_get() >= shot_delay_ms / 4) {
		page_no--;
		ui_request_next_page();
	}
	if (!zoomed && (zoom_pct > 0 || fit_page || text_view) && k_uptime_get() >= shot_delay_ms / 2) {
		zoomed = true;
		if (text_view) {
			ui_set_text_view(true);
		} else {
			ui_set_zoom(fit_page ? 0 : (int)zoom_pct);
		}
	}
	if (done || shot_path == NULL || k_uptime_get() < shot_delay_ms) {
		return;
	}
	done = true;

	lv_draw_buf_t *buf = lv_snapshot_take(lv_screen_active(), LV_COLOR_FORMAT_RGB888);

	if (buf == NULL) {
		printk("screenshot: snapshot failed\n");
		return;
	}
	FILE *fp = fopen(shot_path, "wb");

	if (fp == NULL) {
		printk("screenshot: cannot write %s\n", shot_path);
		lv_draw_buf_destroy(buf);
		return;
	}
	uint32_t w = buf->header.w, h = buf->header.h, stride = buf->header.stride;

	fprintf(fp, "P6\n%u %u\n255\n", w, h);
	for (uint32_t y = 0; y < h; y++) {
		const uint8_t *row = (const uint8_t *)buf->data + y * stride;

		for (uint32_t x = 0; x < w; x++) {
			/* LVGL RGB888 is stored as B, G, R */
			uint8_t px[3] = {row[x * 3 + 2], row[x * 3 + 1], row[x * 3]};

			fwrite(px, 1, 3, fp);
		}
	}
	fclose(fp);
	lv_draw_buf_destroy(buf);
	printk("screenshot: wrote %s (%ux%u)\n", shot_path, w, h);
}
```

## src/screenshot_host.h
```c
/*
 * Copyright (c) 2026 Muhammad Waleed Badar
 * SPDX-License-Identifier: GPL-3.0-only
 */
#ifndef ZPDF_APP_SCREENSHOT_HOST_H
#define ZPDF_APP_SCREENSHOT_HOST_H

#if defined(CONFIG_BOARD_NATIVE_SIM)
void screenshot_poll(void);
#else
static inline void screenshot_poll(void)
{
}
#endif

#endif
```

## src/sd_tuning.c
```c
/*
 * Copyright (c) 2026 Muhammad Waleed Badar
 * SPDX-License-Identifier: GPL-3.0-only
 *
 * ESP32-S3 SD slot tuning the Zephyr driver does not expose: pad drive
 * strength of the slot pins (the driver only sets it on its own pin path,
 * not through pinctrl) and the input delay phase of the SDMMC host, which
 * high speed mode (40 MHz) needs on boards whose slot goes through the
 * GPIO matrix. Applied after the driver's init and before the card is
 * initialised.
 */
#include <zephyr/kernel.h>
#include <zephyr/logging/log.h>
#include <hal/gpio_ll.h>
#include <hal/sdmmc_ll.h>
#include <soc/sdmmc_struct.h>

LOG_MODULE_REGISTER(sd_tuning, LOG_LEVEL_INF);

static const int sd_pins[] = {14, 15, 16, 17, 18, 21}; /* CLK, D2, D0, CMD, D1, D3 */

void sd_tuning_apply(void)
{
#if CONFIG_ZPDF_APP_SD_DRIVE_STRENGTH >= 0
	for (size_t i = 0; i < ARRAY_SIZE(sd_pins); i++) {
		gpio_ll_set_drive_capability(&GPIO, sd_pins[i], (gpio_drive_cap_t)CONFIG_ZPDF_APP_SD_DRIVE_STRENGTH);
	}
	LOG_INF("SD pad drive strength %d", CONFIG_ZPDF_APP_SD_DRIVE_STRENGTH);
#endif
#if SDMMC_LL_DELAY_PHASE_SUPPORTED
	sdmmc_ll_set_din_delay_phase(&SDMMC, (sdmmc_ll_delay_phase_t)CONFIG_ZPDF_APP_SD_DIN_PHASE,
				     SDMMC_LL_SPEED_MODE_LS);
	LOG_INF("SD input delay phase %d", CONFIG_ZPDF_APP_SD_DIN_PHASE);
#endif
}
```

## src/storage.h
```c
/*
 * Copyright (c) 2026 Muhammad Waleed Badar
 * SPDX-License-Identifier: GPL-3.0-only
 *
 * Where documents come from. Two implementations: the mounted file system
 * (SD card) and host files on native_sim.
 */
#ifndef ZPDF_APP_STORAGE_H
#define ZPDF_APP_STORAGE_H

#include <stddef.h>
#include <stdint.h>
#include <stdbool.h>

typedef void (*storage_list_cb)(const char *path, const char *name, void *user_data);

/* Mount or otherwise prepare the storage. Returns 0 or a negative errno. */
int storage_init(void);

/* Call cb for every PDF document found. Returns the count or a negative errno. */
int storage_list(storage_list_cb cb, void *user_data);

/*
 * Read a whole document into a buffer from the PDF allocator (PSRAM on the
 * ESP32-S3). Free it with storage_free(). Returns 0 or a negative errno.
 */
int storage_read(const char *path, uint8_t **buf, size_t *len);
void storage_free(uint8_t *buf);

/* True when the first document should be opened without user interaction. */
bool storage_auto_open(void);

/* One line describing the storage for the user interface. */
const char *storage_describe(void);

#endif
```

## src/storage_fs.c
```c
/*
 * Copyright (c) 2026 Muhammad Waleed Badar
 * SPDX-License-Identifier: GPL-3.0-only
 */
#include "storage.h"
#include <zephyr/kernel.h>
#include <zephyr/fs/fs.h>
#include <zephyr/storage/disk_access.h>
#include <zephyr/logging/log.h>
#include <ff.h>
#include <string.h>
#include <errno.h>

/* The library allocator puts large buffers in external RAM. */
void *pdf_malloc(size_t n);
void pdf_free(void *p);

LOG_MODULE_REGISTER(storage, LOG_LEVEL_INF);

static FATFS fat_fs;
static struct fs_mount_t mp = {
	.type = FS_FATFS,
	.fs_data = &fat_fs,
	.mnt_point = CONFIG_ZPDF_APP_MOUNT_POINT,
	/* never format a card that cannot be read; the user's data is on it */
	.flags = FS_MOUNT_FLAG_NO_FORMAT,
};
static bool mounted;
static char describe_buf[48];

int storage_init(void)
{
	uint32_t sectors = 0, sector_size = 0;

	if (mounted) {
		return 0;
	}
	int rc = disk_access_ioctl(CONFIG_ZPDF_APP_DISK_NAME, DISK_IOCTL_CTRL_INIT, NULL);

	if (rc != 0) {
		LOG_ERR("no SD card (%d)", rc);
		snprintf(describe_buf, sizeof(describe_buf), "No SD card found");
		return rc;
	}
	disk_access_ioctl(CONFIG_ZPDF_APP_DISK_NAME, DISK_IOCTL_GET_SECTOR_COUNT, &sectors);
	disk_access_ioctl(CONFIG_ZPDF_APP_DISK_NAME, DISK_IOCTL_GET_SECTOR_SIZE, &sector_size);

	rc = fs_mount(&mp);
	if (rc != 0) {
		LOG_ERR("mount %s failed (%d)", mp.mnt_point, rc);
		snprintf(describe_buf, sizeof(describe_buf), "SD card: cannot mount (%d)", rc);
		return rc;
	}
	mounted = true;
	uint32_t mb = (uint32_t)(((uint64_t)sectors * sector_size) >> 20);

	snprintf(describe_buf, sizeof(describe_buf), "SD card, %u MB", mb);
	LOG_INF("mounted %s (%u MB)", mp.mnt_point, mb);
	return 0;
}

static bool is_pdf(const char *name)
{
	size_t n = strlen(name);

	if (n < 4) {
		return false;
	}
	const char *ext = name + n - 4;

	return (ext[0] == '.') && (ext[1] == 'p' || ext[1] == 'P') && (ext[2] == 'd' || ext[2] == 'D') &&
	       (ext[3] == 'f' || ext[3] == 'F');
}

int storage_list(storage_list_cb cb, void *user_data)
{
	struct fs_dir_t dir;
	struct fs_dirent ent;
	char path[CONFIG_FS_FATFS_MAX_LFN + 16];
	int count = 0;

	if (!mounted) {
		return -ENODEV;
	}
	fs_dir_t_init(&dir);
	int rc = fs_opendir(&dir, CONFIG_ZPDF_APP_MOUNT_POINT);

	if (rc != 0) {
		return rc;
	}
	while (count < CONFIG_ZPDF_APP_MAX_FILES) {
		rc = fs_readdir(&dir, &ent);
		if (rc != 0 || ent.name[0] == 0) {
			break;
		}
		if (ent.type != FS_DIR_ENTRY_FILE || !is_pdf(ent.name)) {
			continue;
		}
		snprintf(path, sizeof(path), "%s/%s", CONFIG_ZPDF_APP_MOUNT_POINT, ent.name);
		cb(path, ent.name, user_data);
		count++;
	}
	fs_closedir(&dir);
	return count;
}

int storage_read(const char *path, uint8_t **buf, size_t *len)
{
	struct fs_file_t file;
	struct fs_dirent ent;

	*buf = NULL;
	*len = 0;
	int rc = fs_stat(path, &ent);

	if (rc != 0) {
		return rc;
	}
	if (ent.size == 0) {
		return -EINVAL;
	}
	if (ent.size > CONFIG_ZPDF_APP_MAX_FILE_SIZE) {
		return -EFBIG;
	}
	uint8_t *data = pdf_malloc(ent.size + 1);

	if (data == NULL) {
		return -ENOMEM;
	}
	fs_file_t_init(&file);
	rc = fs_open(&file, path, FS_O_READ);
	if (rc != 0) {
		pdf_free(data);
		return rc;
	}
	size_t got = 0;

	while (got < ent.size) {
		ssize_t n = fs_read(&file, data + got, ent.size - got);

		if (n < 0) {
			rc = (int)n;
			break;
		}
		if (n == 0) {
			break;
		}
		got += (size_t)n;
	}
	fs_close(&file);
	if (rc != 0 || got == 0) {
		pdf_free(data);
		return rc != 0 ? rc : -EIO;
	}
	data[got] = 0;
	*buf = data;
	*len = got;
	return 0;
}

void storage_free(uint8_t *buf)
{
	pdf_free(buf);
}

bool storage_auto_open(void)
{
	return IS_ENABLED(CONFIG_ZPDF_APP_AUTO_OPEN) && mounted;
}

const char *storage_describe(void)
{
	return describe_buf;
}
```

## src/storage_host.c
```c
/*
 * Copyright (c) 2026 Muhammad Waleed Badar
 * SPDX-License-Identifier: GPL-3.0-only
 *
 * native_sim: documents are files of the host, named on the command line:
 *   zephyr.exe --pdf=/path/one.pdf --pdf=/path/two.pdf
 */
#include "storage.h"
#include <zephyr/kernel.h>
#include <zephyr/logging/log.h>
#include <posix_native_task.h>
#include <cmdline.h>
#include <nsi_host_trampolines.h>
#include <string.h>
#include <errno.h>

void *pdf_malloc(size_t n);
void *pdf_realloc(void *p, size_t n);
void pdf_free(void *p);

LOG_MODULE_REGISTER(storage, LOG_LEVEL_INF);

static char *pdf_arg;
static bool auto_open;
static const char *files[CONFIG_ZPDF_APP_MAX_FILES];
static int nfiles;

static void pdf_arg_found(char *argv, int offset)
{
	ARG_UNUSED(argv);
	ARG_UNUSED(offset);
	if (nfiles < CONFIG_ZPDF_APP_MAX_FILES && pdf_arg != NULL) {
		files[nfiles++] = nsi_host_strdup(pdf_arg);
	}
}

static void add_options(void)
{
	static struct args_struct_t options[] = {
		{
			.option = "pdf",
			.name = "path",
			.type = 's',
			.dest = (void *)&pdf_arg,
			.call_when_found = pdf_arg_found,
			.descript = "PDF document to list in the reader (may be repeated)",
		},
		{
			.is_switch = true,
			.option = "open",
			.type = 'b',
			.dest = (void *)&auto_open,
			.descript = "Open the first document right away (for testing)",
		},
		ARG_TABLE_ENDMARKER,
	};

	native_add_command_line_opts(options);
}

NATIVE_TASK(add_options, PRE_BOOT_1, 10);

int storage_init(void)
{
	return nfiles > 0 ? 0 : -ENOENT;
}

int storage_list(storage_list_cb cb, void *user_data)
{
	for (int i = 0; i < nfiles; i++) {
		const char *slash = strrchr(files[i], '/');

		cb(files[i], slash ? slash + 1 : files[i], user_data);
	}
	return nfiles;
}

int storage_read(const char *path, uint8_t **buf, size_t *len)
{
	*buf = NULL;
	*len = 0;
	int fd = nsi_host_open(path, 0 /* O_RDONLY */);

	if (fd < 0) {
		return -ENOENT;
	}
	size_t cap = 256 * 1024, n = 0;
	uint8_t *data = pdf_malloc(cap + 1);

	if (data == NULL) {
		nsi_host_close(fd);
		return -ENOMEM;
	}
	for (;;) {
		if (n == cap) {
			if (cap >= CONFIG_ZPDF_APP_MAX_FILE_SIZE) {
				pdf_free(data);
				nsi_host_close(fd);
				return -EFBIG;
			}
			cap *= 2;
			uint8_t *d = pdf_realloc(data, cap + 1);

			if (d == NULL) {
				pdf_free(data);
				nsi_host_close(fd);
				return -ENOMEM;
			}
			data = d;
		}
		long r = nsi_host_read(fd, data + n, cap - n);

		if (r < 0) {
			pdf_free(data);
			nsi_host_close(fd);
			return -EIO;
		}
		if (r == 0) {
			break;
		}
		n += (size_t)r;
	}
	nsi_host_close(fd);
	if (n == 0) {
		pdf_free(data);
		return -EINVAL;
	}
	data[n] = 0;
	*buf = data;
	*len = n;
	return 0;
}

void storage_free(uint8_t *buf)
{
	pdf_free(buf);
}

bool storage_auto_open(void)
{
	return auto_open && nfiles > 0;
}

const char *storage_describe(void)
{
	return nfiles > 0 ? "Host files (--pdf=...)" : "No documents: run with --pdf=<file>";
}
```

## src/ui.h
```c
/*
 * Copyright (c) 2026 Muhammad Waleed Badar
 * SPDX-License-Identifier: GPL-3.0-only
 */
#ifndef ZPDF_APP_UI_H
#define ZPDF_APP_UI_H

#include <stdbool.h>

/* Build the screens and show the document list. Call with LVGL ready. */
void ui_init(void);

/* Requests from other threads (buttons); handled on the LVGL thread. */
void ui_request_next_page(void);
void ui_request_prev_page(void);

/* Set the page zoom in percent of fit-to-width (LVGL thread only). */
void ui_set_zoom(int pct);

/* Switch between the page view and the text view (LVGL thread only). */
void ui_set_text_view(bool text);

/* Run pending requests; call from the thread that runs lv_timer_handler(). */
void ui_poll(void);

#endif
```

## src/worker.c
```c
/*
 * Copyright (c) 2026 Muhammad Waleed Badar
 * SPDX-License-Identifier: GPL-3.0-only
 */
#include "worker.h"
#include <zpdf/pdf_render.h>
#include <zpdf/pdf_text.h>
#include <zephyr/kernel.h>
#include <zephyr/logging/log.h>

void *pdf_malloc(size_t n);
void *pdf_realloc(void *p, size_t n);
void pdf_free(void *p);

LOG_MODULE_REGISTER(worker, LOG_LEVEL_INF);

K_THREAD_STACK_DEFINE(worker_stack, CONFIG_ZPDF_APP_RENDER_STACK_SIZE);

static struct k_work_q queue;
static struct k_work work;
static struct k_mutex lock;

struct request {
	enum worker_kind kind;
	struct pdf_doc *doc;
	size_t page;
	int zoom_pct;
	float scale;
	int x, y, w, h;
};

static struct request pending;
static bool pending_valid;
static struct worker_result result;
static bool result_valid;
static atomic_t busy;

static void free_result(struct worker_result *r)
{
	pdf_free(r->px);
	pdf_free(r->text);
	r->px = NULL;
	r->text = NULL;
}

static void handler(struct k_work *w)
{
	ARG_UNUSED(w);
	for (;;) {
		struct request req;

		k_mutex_lock(&lock, K_FOREVER);
		if (!pending_valid) {
			atomic_set(&busy, 0);
			k_mutex_unlock(&lock);
			return;
		}
		req = pending;
		pending_valid = false;
		k_mutex_unlock(&lock);

		struct worker_result r = {.kind = req.kind, .page = req.page, .zoom_pct = req.zoom_pct};
		int64_t t0 = k_uptime_get();

		if (req.kind == WORKER_RENDER) {
			{
				struct pdf_bitmap bm;

				r.x = req.x;
				r.y = req.y;
				r.error = pdf_render_region(req.doc, req.page, req.scale, req.x, req.y, req.w, req.h, &bm);
				if (r.error != 0) {
					LOG_WRN("render failed: scale %d/1000 region %d,%d %dx%d", (int)(req.scale * 1000),
						req.x, req.y, req.w, req.h);
				}
				if (r.error == 0) {
					/*
					 * Convert to RGB565 in place: the 2-byte pixel i is written
					 * at offset 2i while the 3-byte source sits at 3i, so a
					 * forward pass never overwrites unread data. No second
					 * buffer is needed at the peak of memory use.
					 */
					size_t n = (size_t)bm.w * (size_t)bm.h;
					uint16_t *dst = (uint16_t *)bm.rgb;

					for (size_t i = 0; i < n; i++) {
						const uint8_t *src = bm.rgb + i * 3;
						uint16_t v = (uint16_t)(((src[0] & 0xF8) << 8) | ((src[1] & 0xFC) << 3) |
									(src[2] >> 3));

						dst[i] = v;
					}
					uint16_t *shrunk = pdf_realloc(bm.rgb, n * 2);

					r.px = shrunk != NULL ? shrunk : dst;
					r.w = bm.w;
					r.h = bm.h;
				}
			}
		} else if (req.kind == WORKER_TEXT) {
			r.error = pdf_page_text(req.doc, req.page, &r.text);
		}
		r.ms = (uint32_t)(k_uptime_get() - t0);
		LOG_INF("%s page %u (%d%%, %dx%d at %d,%d) done in %u ms (%d)",
			req.kind == WORKER_RENDER ? "render" : "text", (unsigned)req.page + 1, req.zoom_pct, r.w, r.h,
			r.x, r.y, r.ms, r.error);

		k_mutex_lock(&lock, K_FOREVER);
		if (result_valid) {
			free_result(&result);
		}
		result = r;
		result_valid = true;
		k_mutex_unlock(&lock);
	}
}

void worker_init(void)
{
	k_mutex_init(&lock);
	k_work_init(&work, handler);
	k_work_queue_init(&queue);
	k_work_queue_start(&queue, worker_stack, K_THREAD_STACK_SIZEOF(worker_stack),
			   CONFIG_ZPDF_APP_RENDER_PRIORITY, NULL);
	k_thread_name_set(k_work_queue_thread_get(&queue), "pdf_worker");
}

static void submit(const struct request *req)
{
	k_mutex_lock(&lock, K_FOREVER);
	pending = *req;
	pending_valid = true;
	atomic_set(&busy, 1);
	k_mutex_unlock(&lock);
	k_work_submit_to_queue(&queue, &work);
}

void worker_request_render(struct pdf_doc *doc, size_t page, float scale, int zoom_pct, int x, int y,
			   int w, int h)
{
	struct request req = {.kind = WORKER_RENDER, .doc = doc, .page = page, .zoom_pct = zoom_pct,
			      .scale = scale, .x = x, .y = y, .w = w, .h = h};

	submit(&req);
}

void worker_request_text(struct pdf_doc *doc, size_t page)
{
	struct request req = {.kind = WORKER_TEXT, .doc = doc, .page = page, .zoom_pct = 100};

	submit(&req);
}

bool worker_take_result(struct worker_result *out)
{
	bool got = false;

	k_mutex_lock(&lock, K_FOREVER);
	if (result_valid) {
		*out = result;
		result_valid = false;
		got = true;
	}
	k_mutex_unlock(&lock);
	return got;
}

void worker_drain(void)
{
	struct k_work_sync sync;

	k_mutex_lock(&lock, K_FOREVER);
	pending_valid = false;
	k_mutex_unlock(&lock);
	k_work_flush(&work, &sync);
	k_mutex_lock(&lock, K_FOREVER);
	if (result_valid) {
		free_result(&result);
		result_valid = false;
	}
	k_mutex_unlock(&lock);
}

bool worker_busy(void)
{
	return atomic_get(&busy) != 0;
}
```

## src/worker.h
```c
/*
 * Copyright (c) 2026 Muhammad Waleed Badar
 * SPDX-License-Identifier: GPL-3.0-only
 *
 * Background worker that owns all access to the open document: page
 * rendering and text extraction run here so the UI thread stays
 * responsive. Results are polled from the UI thread.
 */
#ifndef ZPDF_APP_WORKER_H
#define ZPDF_APP_WORKER_H

#include <zpdf/pdf_doc.h>
#include <stdbool.h>
#include <stddef.h>
#include <stdint.h>

enum worker_kind {
	WORKER_NONE = 0,
	WORKER_RENDER,
	WORKER_TEXT,
};

struct worker_result {
	enum worker_kind kind;
	size_t page;
	int zoom_pct;
	/* render: the tile (x, y, w, h) of the page at the requested scale */
	uint16_t *px; /* RGB565, from pdf_malloc; the receiver frees it */
	int x, y, w, h;
	/* text */
	char *text; /* from pdf_malloc; the receiver frees it */
	int error;
	uint32_t ms;
};

void worker_init(void);
/*
 * Replace any pending request: render the tile (x, y, w, h) of @page at
 * @scale device pixels per point. @zoom_pct only tags the result.
 */
void worker_request_render(struct pdf_doc *doc, size_t page, float scale, int zoom_pct, int x, int y,
			   int w, int h);
void worker_request_text(struct pdf_doc *doc, size_t page);
/* Fetch a finished result; returns false when none is ready. */
bool worker_take_result(struct worker_result *out);
/* Block until the worker is idle (before closing the document). */
void worker_drain(void);
bool worker_busy(void);

#endif
```
