## CMakeLists.txt
```
# Copyright (c) 2026 Muhammad Waleed Badar
# SPDX-License-Identifier: GPL-3.0-only

cmake_minimum_required(VERSION 3.20.0)

find_package(Zephyr REQUIRED HINTS $ENV{ZEPHYR_BASE})
project(zpdf_test LANGUAGES C)

target_sources(app PRIVATE src/main.c)
# the inflate unit test uses the library's internal header
target_include_directories(app PRIVATE ${ZEPHYR_ZPDF_MODULE_DIR}/lib/zpdf)
```

## Kconfig
```
# Copyright (c) 2026 Muhammad Waleed Badar
# SPDX-License-Identifier: GPL-3.0-only

config ZPDF_TEST_RENDER
	bool "Run the rendering tests (need about 1 MB of heap)"
	default y

source "Kconfig.zephyr"
```

## prj.conf
```kconfig
# Copyright (c) 2026 Muhammad Waleed Badar
# SPDX-License-Identifier: GPL-3.0-only

CONFIG_ZTEST=y
CONFIG_ZPDF=y
CONFIG_ZPDF_LOG_LEVEL=2
CONFIG_LOG=y
CONFIG_HEAP_MEM_POOL_SIZE=1048576
CONFIG_MAIN_STACK_SIZE=16384
CONFIG_ZTEST_STACK_SIZE=16384
```

## boards/qemu_cortex_m3.conf
```kconfig
# Copyright (c) 2026 Muhammad Waleed Badar
# SPDX-License-Identifier: GPL-3.0-only

# 64 KB of RAM: the generated test documents are a few hundred bytes
CONFIG_HEAP_MEM_POOL_SIZE=24576
# rendering tests need more RAM than this board has
CONFIG_ZPDF_TEST_RENDER=n
CONFIG_MAIN_STACK_SIZE=4096
CONFIG_ZTEST_STACK_SIZE=8192
```

## src/main.c
```c
/*
 * Copyright (c) 2026 Muhammad Waleed Badar
 * SPDX-License-Identifier: GPL-3.0-only
 *
 * Parser tests on small generated documents (see gen_test_pdfs.py).
 */
#include <zephyr/ztest.h>
#include <zpdf/pdf_doc.h>
#include <zpdf/pdf_text.h>
#include <zpdf/pdf_render.h>
#include "inflate.h"
#include "pdf_mem.h"
#include <string.h>
#include "test_pdfs.h"

static void check_hello(const uint8_t *data, size_t len, const char *what)
{
	char err[48] = "";
	struct pdf_doc *doc = pdf_open(data, len, err, sizeof(err));

	zassert_not_null(doc, "%s: open failed: %s", what, err);
	zassert_equal(pdf_page_count(doc), 1, "%s: page count", what);
	zassert_false(pdf_is_encrypted(doc), "%s: not encrypted", what);

	char *text = NULL;

	zassert_equal(pdf_page_text(doc, 0, &text), 0, "%s: extract", what);
	zassert_not_null(text, "%s: text", what);
	/* "Hello Zephyr", then "PDF reader" from a TJ array with a word gap, then a new line */
	zassert_str_equal(text, "Hello Zephyr\nPDF reader\nsecond line", "%s: got '%s'", what, text);
	pdf_text_free(text);
	pdf_close(doc);
}

ZTEST(zpdf, test_plain_xref_table)
{
	check_hello(pdf_plain, sizeof(pdf_plain), "plain");
}

ZTEST(zpdf, test_xref_stream_and_object_streams)
{
	check_hello(pdf_xref_stream, sizeof(pdf_xref_stream), "xref stream");
}

ZTEST(zpdf, test_damaged_startxref_is_reconstructed)
{
	check_hello(pdf_broken_startxref, sizeof(pdf_broken_startxref), "broken startxref");
}

ZTEST(zpdf, test_truncated_file_is_reconstructed)
{
	check_hello(pdf_truncated, sizeof(pdf_truncated), "truncated");
}

ZTEST(zpdf, test_type0_font_with_tounicode)
{
	char err[48] = "";
	struct pdf_doc *doc = pdf_open(pdf_type0, sizeof(pdf_type0), err, sizeof(err));

	zassert_not_null(doc, "open failed: %s", err);
	char *text = NULL;

	zassert_equal(pdf_page_text(doc, 0, &text), 0);
	/* codes 1..5: Z, e f g (bfrange), fi ligature (U+FB01) */
	zassert_str_equal(text, "Zefg\xEF\xAC\x81", "got '%s'", text);
	pdf_text_free(text);
	pdf_close(doc);
}

ZTEST(zpdf, test_page_attributes)
{
	struct pdf_doc *doc = pdf_open(pdf_plain, sizeof(pdf_plain), NULL, 0);

	zassert_not_null(doc);
	struct pdf_obj *page = pdf_page(doc, 0);
	struct pdf_obj *mb = pdf_page_attr(doc, page, "MediaBox");

	zassert_not_null(mb);
	zassert_equal(mb->type, PDF_ARRAY);
	zassert_equal(pdf_array_len(mb), 4);
	zassert_equal((int)pdf_num(pdf_array_get(doc, mb, 2)), 300);
	zassert_is_null(pdf_page(doc, 1));
	pdf_close(doc);
}

ZTEST(zpdf, test_rejects_garbage)
{
	static const uint8_t junk[64] = "this is not a pdf file at all, just some text to fill space";
	char err[48] = "";

	zassert_is_null(pdf_open(junk, sizeof(junk), err, sizeof(err)));
	zassert_true(strlen(err) > 0);
	zassert_is_null(pdf_open(pdf_plain, 8, err, sizeof(err)));
}

ZTEST(zpdf, test_inflate_stored_and_fixed)
{
	/* zlib stream of "Hello Hello Hello" with a fixed Huffman block */
	static const uint8_t z[] = {0x78, 0x9c, 0xf3, 0x48, 0xcd, 0xc9, 0xc9, 0x57, 0xf0, 0x40,
				    0x90, 0x00, 0x36, 0x0e, 0x06, 0x1d};
	uint8_t *out = NULL;
	size_t out_len = 0;

	zassert_equal(inflate_buf(z, sizeof(z), &out, &out_len), 0);
	zassert_equal(out_len, 17);
	zassert_mem_equal(out, "Hello Hello Hello", 17);
	pdf_free(out);

	/* truncated input: partial output is still returned */
	zassert_equal(inflate_buf(z, 8, &out, &out_len), 1);
	zassert_true(out_len > 0 && out_len < 17);
	zassert_mem_equal(out, "Hello", 5);
	pdf_free(out);

	/* garbage */
	static const uint8_t bad[] = {0x78, 0x9c, 0xff, 0xff, 0xff, 0xff};

	zassert_true(inflate_buf(bad, sizeof(bad), &out, &out_len) < 0);
	zassert_is_null(out);
}

ZTEST(zpdf, test_render_plain_page)
{
	if (!IS_ENABLED(CONFIG_ZPDF_TEST_RENDER)) {
		ztest_test_skip();
	}
	struct pdf_doc *doc = pdf_open(pdf_plain, sizeof(pdf_plain), NULL, 0);
	float w, h;

	zassert_not_null(doc);
	zassert_equal(pdf_page_size(doc, 0, &w, &h), 0);
	zassert_equal((int)w, 300);
	zassert_equal((int)h, 200);

	struct pdf_bitmap bm;

	zassert_equal(pdf_render_page(doc, 0, 1.0f, &bm), 0);
	zassert_equal(bm.w, 300);
	zassert_equal(bm.h, 200);
	zassert_not_null(bm.rgb);

	/* "Hello Zephyr" at 20,150 (14 pt Helvetica): dark pixels in that band, none at the bottom */
	long dark_text = 0, dark_bottom = 0;

	for (int y = 200 - 150 - 12; y < 200 - 150 + 2; y++) {
		for (int x = 20; x < 120; x++) {
			if (bm.rgb[(y * bm.w + x) * 3] < 128) {
				dark_text++;
			}
		}
	}
	for (int y = 180; y < 200; y++) {
		for (int x = 0; x < 300; x++) {
			if (bm.rgb[(y * bm.w + x) * 3] < 128) {
				dark_bottom++;
			}
		}
	}
	zassert_true(dark_text > 50, "text pixels: %ld", dark_text);
	zassert_equal(dark_bottom, 0, "stray pixels: %ld", dark_bottom);
	pdf_bitmap_free(&bm);
	pdf_close(doc);
}

ZTEST(zpdf, test_render_type0_glyphs)
{
	if (!IS_ENABLED(CONFIG_ZPDF_TEST_RENDER)) {
		ztest_test_skip();
	}
	struct pdf_doc *doc = pdf_open(pdf_type0, sizeof(pdf_type0), NULL, 0);
	struct pdf_bitmap bm;

	zassert_not_null(doc);
	/* the font has no program: glyphs come from the built-in fallback font */
	zassert_equal(pdf_render_page(doc, 0, 2.0f, &bm), 0);
	long dark = 0;

	for (size_t i = 0; i < (size_t)bm.w * bm.h; i++) {
		if (bm.rgb[i * 3] < 128) {
			dark++;
		}
	}
	zassert_true(dark > 20, "glyph pixels: %ld", dark);
	pdf_bitmap_free(&bm);
	pdf_close(doc);
}

ZTEST_SUITE(zpdf, NULL, NULL, NULL, NULL, NULL);
```

## src/test_pdfs.h
```c
/* Generated by gen_test_pdfs.py: small documents for the zpdf tests. */
#include <stdint.h>

static const uint8_t pdf_plain[] = {
	0x25, 0x50, 0x44, 0x46, 0x2d, 0x31, 0x2e, 0x34, 0x0a, 0x25, 0xe2, 0xe3, 0xcf, 0xd3, 0x0a, 0x31,
	0x20, 0x30, 0x20, 0x6f, 0x62, 0x6a, 0x0a, 0x3c, 0x3c, 0x20, 0x2f, 0x54, 0x79, 0x70, 0x65, 0x20,
	0x2f, 0x43, 0x61, 0x74, 0x61, 0x6c, 0x6f, 0x67, 0x20, 0x2f, 0x50, 0x61, 0x67, 0x65, 0x73, 0x20,
	0x32, 0x20, 0x30, 0x20, 0x52, 0x20, 0x3e, 0x3e, 0x0a, 0x65, 0x6e, 0x64, 0x6f, 0x62, 0x6a, 0x0a,
	0x32, 0x20, 0x30, 0x20, 0x6f, 0x62, 0x6a, 0x0a, 0x3c, 0x3c, 0x20, 0x2f, 0x54, 0x79, 0x70, 0x65,
	0x20, 0x2f, 0x50, 0x61, 0x67, 0x65, 0x73, 0x20, 0x2f, 0x4b, 0x69, 0x64, 0x73, 0x20, 0x5b, 0x33,
	0x20, 0x30, 0x20, 0x52, 0x5d, 0x20, 0x2f, 0x43, 0x6f, 0x75, 0x6e, 0x74, 0x20, 0x31, 0x20, 0x3e,
	0x3e, 0x0a, 0x65, 0x6e, 0x64, 0x6f, 0x62, 0x6a, 0x0a, 0x33, 0x20, 0x30, 0x20, 0x6f, 0x62, 0x6a,
	0x0a, 0x3c, 0x3c, 0x20, 0x2f, 0x54, 0x79, 0x70, 0x65, 0x20, 0x2f, 0x50, 0x61, 0x67, 0x65, 0x20,
	0x2f, 0x50, 0x61, 0x72, 0x65, 0x6e, 0x74, 0x20, 0x32, 0x20, 0x30, 0x20, 0x52, 0x20, 0x2f, 0x4d,
	0x65, 0x64, 0x69, 0x61, 0x42, 0x6f, 0x78, 0x20, 0x5b, 0x30, 0x20, 0x30, 0x20, 0x33, 0x30, 0x30,
	0x20, 0x32, 0x30, 0x30, 0x5d, 0x20, 0x2f, 0x52, 0x65, 0x73, 0x6f, 0x75, 0x72, 0x63, 0x65, 0x73,
	0x20, 0x3c, 0x3c, 0x20, 0x2f, 0x46, 0x6f, 0x6e, 0x74, 0x20, 0x3c, 0x3c, 0x20, 0x2f, 0x46, 0x31,
	0x20, 0x35, 0x20, 0x30, 0x20, 0x52, 0x20, 0x3e, 0x3e, 0x20, 0x3e, 0x3e, 0x20, 0x2f, 0x43, 0x6f,
	0x6e, 0x74, 0x65, 0x6e, 0x74, 0x73, 0x20, 0x34, 0x20, 0x30, 0x20, 0x52, 0x20, 0x3e, 0x3e, 0x0a,
	0x65, 0x6e, 0x64, 0x6f, 0x62, 0x6a, 0x0a, 0x34, 0x20, 0x30, 0x20, 0x6f, 0x62, 0x6a, 0x0a, 0x3c,
	0x3c, 0x20, 0x2f, 0x4c, 0x65, 0x6e, 0x67, 0x74, 0x68, 0x20, 0x31, 0x30, 0x39, 0x20, 0x3e, 0x3e,
	0x0a, 0x73, 0x74, 0x72, 0x65, 0x61, 0x6d, 0x0a, 0x42, 0x54, 0x20, 0x2f, 0x46, 0x31, 0x20, 0x31,
	0x34, 0x20, 0x54, 0x66, 0x20, 0x32, 0x30, 0x20, 0x31, 0x35, 0x30, 0x20, 0x54, 0x64, 0x20, 0x28,
	0x48, 0x65, 0x6c, 0x6c, 0x6f, 0x20, 0x5a, 0x65, 0x70, 0x68, 0x79, 0x72, 0x29, 0x20, 0x54, 0x6a,
	0x20, 0x30, 0x20, 0x2d, 0x32, 0x30, 0x20, 0x54, 0x64, 0x20, 0x5b, 0x28, 0x50, 0x29, 0x20, 0x35,
	0x30, 0x20, 0x28, 0x44, 0x46, 0x29, 0x20, 0x2d, 0x36, 0x30, 0x30, 0x20, 0x28, 0x72, 0x65, 0x61,
	0x64, 0x65, 0x72, 0x29, 0x5d, 0x20, 0x54, 0x4a, 0x20, 0x30, 0x20, 0x2d, 0x32, 0x30, 0x20, 0x54,
	0x64, 0x20, 0x28, 0x73, 0x65, 0x63, 0x6f, 0x6e, 0x64, 0x20, 0x6c, 0x69, 0x6e, 0x65, 0x29, 0x20,
	0x54, 0x6a, 0x20, 0x45, 0x54, 0x0a, 0x65, 0x6e, 0x64, 0x73, 0x74, 0x72, 0x65, 0x61, 0x6d, 0x0a,
	0x65, 0x6e, 0x64, 0x6f, 0x62, 0x6a, 0x0a, 0x35, 0x20, 0x30, 0x20, 0x6f, 0x62, 0x6a, 0x0a, 0x3c,
	0x3c, 0x20, 0x2f, 0x54, 0x79, 0x70, 0x65, 0x20, 0x2f, 0x46, 0x6f, 0x6e, 0x74, 0x20, 0x2f, 0x53,
	0x75, 0x62, 0x74, 0x79, 0x70, 0x65, 0x20, 0x2f, 0x54, 0x79, 0x70, 0x65, 0x31, 0x20, 0x2f, 0x42,
	0x61, 0x73, 0x65, 0x46, 0x6f, 0x6e, 0x74, 0x20, 0x2f, 0x48, 0x65, 0x6c, 0x76, 0x65, 0x74, 0x69,
	0x63, 0x61, 0x20, 0x3e, 0x3e, 0x0a, 0x65, 0x6e, 0x64, 0x6f, 0x62, 0x6a, 0x0a, 0x78, 0x72, 0x65,
	0x66, 0x0a, 0x30, 0x20, 0x36, 0x0a, 0x30, 0x30, 0x30, 0x30, 0x30, 0x30, 0x30, 0x30, 0x30, 0x30,
	0x20, 0x36, 0x35, 0x35, 0x33, 0x35, 0x20, 0x66, 0x20, 0x0a, 0x30, 0x30, 0x30, 0x30, 0x30, 0x30,
	0x30, 0x30, 0x31, 0x35, 0x20, 0x30, 0x30, 0x30, 0x30, 0x30, 0x20, 0x6e, 0x20, 0x0a, 0x30, 0x30,
	0x30, 0x30, 0x30, 0x30, 0x30, 0x30, 0x36, 0x34, 0x20, 0x30, 0x30, 0x30, 0x30, 0x30, 0x20, 0x6e,
	0x20, 0x0a, 0x30, 0x30, 0x30, 0x30, 0x30, 0x30, 0x30, 0x31, 0x32, 0x31, 0x20, 0x30, 0x30, 0x30,
	0x30, 0x30, 0x20, 0x6e, 0x20, 0x0a, 0x30, 0x30, 0x30, 0x30, 0x30, 0x30, 0x30, 0x32, 0x34, 0x37,
	0x20, 0x30, 0x30, 0x30, 0x30, 0x30, 0x20, 0x6e, 0x20, 0x0a, 0x30, 0x30, 0x30, 0x30, 0x30, 0x30,
	0x30, 0x34, 0x30, 0x37, 0x20, 0x30, 0x30, 0x30, 0x30, 0x30, 0x20, 0x6e, 0x20, 0x0a, 0x74, 0x72,
	0x61, 0x69, 0x6c, 0x65, 0x72, 0x0a, 0x3c, 0x3c, 0x20, 0x2f, 0x53, 0x69, 0x7a, 0x65, 0x20, 0x36,
	0x20, 0x2f, 0x52, 0x6f, 0x6f, 0x74, 0x20, 0x31, 0x20, 0x30, 0x20, 0x52, 0x20, 0x3e, 0x3e, 0x0a,
	0x73, 0x74, 0x61, 0x72, 0x74, 0x78, 0x72, 0x65, 0x66, 0x0a, 0x34, 0x37, 0x37, 0x0a, 0x25, 0x25,
	0x45, 0x4f, 0x46, 0x0a,
};
static const uint8_t pdf_xref_stream[] = {
	0x25, 0x50, 0x44, 0x46, 0x2d, 0x31, 0x2e, 0x35, 0x0a, 0x25, 0xe2, 0xe3, 0xcf, 0xd3, 0x0a, 0x36,
	0x20, 0x30, 0x20, 0x6f, 0x62, 0x6a, 0x0a, 0x3c, 0x3c, 0x20, 0x2f, 0x54, 0x79, 0x70, 0x65, 0x20,
	0x2f, 0x4f, 0x62, 0x6a, 0x53, 0x74, 0x6d, 0x20, 0x2f, 0x4e, 0x20, 0x34, 0x20, 0x2f, 0x46, 0x69,
	0x72, 0x73, 0x74, 0x20, 0x32, 0x30, 0x20, 0x2f, 0x4c, 0x65, 0x6e, 0x67, 0x74, 0x68, 0x20, 0x32,
	0x32, 0x31, 0x20, 0x2f, 0x46, 0x69, 0x6c, 0x74, 0x65, 0x72, 0x20, 0x2f, 0x46, 0x6c, 0x61, 0x74,
	0x65, 0x44, 0x65, 0x63, 0x6f, 0x64, 0x65, 0x20, 0x3e, 0x3e, 0x0a, 0x73, 0x74, 0x72, 0x65, 0x61,
	0x6d, 0x0a, 0x78, 0x9c, 0xed, 0x51, 0xcb, 0x6a, 0x03, 0x31, 0x0c, 0xbc, 0xe7, 0x2b, 0xe6, 0x0f,
	0x24, 0xdb, 0xd9, 0xa4, 0x87, 0xb0, 0x90, 0x2c, 0xc9, 0xa5, 0x2d, 0x94, 0x34, 0xd0, 0xc3, 0xb2,
	0x07, 0x37, 0x2b, 0x36, 0x86, 0x60, 0x17, 0xdb, 0x0b, 0xc9, 0xdf, 0x97, 0x7d, 0xd0, 0x1e, 0xf2,
	0x01, 0xbd, 0x14, 0x24, 0xa1, 0xd1, 0x8c, 0xc4, 0x80, 0x14, 0x18, 0x1a, 0x66, 0x09, 0x83, 0xf5,
	0x0a, 0x05, 0xd4, 0xd3, 0x1a, 0x9b, 0x0d, 0xe8, 0x74, 0xff, 0x12, 0x50, 0x65, 0xb3, 0xbd, 0x86,
	0x0e, 0xf4, 0x66, 0x3b, 0x49, 0xd0, 0x60, 0x1c, 0x51, 0x96, 0x8b, 0x5f, 0xc5, 0x44, 0xd0, 0xb3,
	0x6b, 0x13, 0x6a, 0x33, 0xf0, 0x0d, 0xa8, 0x0a, 0xbd, 0xcf, 0x50, 0x8f, 0xca, 0xa1, 0x46, 0xf1,
	0x79, 0xbe, 0x44, 0xaf, 0xd2, 0x3a, 0xbb, 0x0b, 0x37, 0xd4, 0x0c, 0x86, 0x61, 0x86, 0x66, 0x6e,
	0x40, 0x47, 0x49, 0xa1, 0x8f, 0x67, 0x49, 0xa3, 0x97, 0x43, 0xf0, 0x79, 0x6a, 0x14, 0x8a, 0xd9,
	0xc2, 0x10, 0x54, 0x05, 0x9f, 0xc5, 0xe7, 0x84, 0xe5, 0xa3, 0xb1, 0x71, 0x89, 0xde, 0xfb, 0xcf,
	0x3c, 0xc2, 0x53, 0xec, 0x65, 0x22, 0x76, 0x36, 0xc9, 0x44, 0x6e, 0xa3, 0xb3, 0x57, 0xd0, 0xc1,
	0xc5, 0x94, 0xab, 0x8b, 0x8d, 0x30, 0x1a, 0xf4, 0x62, 0x67, 0xa0, 0xf4, 0x0a, 0xf4, 0xe1, 0xda,
	0x7c, 0x49, 0xa8, 0x0b, 0x66, 0xfc, 0xe7, 0x9f, 0x64, 0x03, 0xda, 0xfb, 0x73, 0x68, 0x9d, 0xef,
	0x86, 0x7f, 0xf8, 0xad, 0x4f, 0xee, 0x67, 0x50, 0x96, 0x8b, 0x6f, 0xad, 0x54, 0xa0, 0x37, 0x0a,
	0x65, 0x6e, 0x64, 0x73, 0x74, 0x72, 0x65, 0x61, 0x6d, 0x0a, 0x65, 0x6e, 0x64, 0x6f, 0x62, 0x6a,
	0x0a, 0x34, 0x20, 0x30, 0x20, 0x6f, 0x62, 0x6a, 0x0a, 0x3c, 0x3c, 0x20, 0x2f, 0x4c, 0x65, 0x6e,
	0x67, 0x74, 0x68, 0x20, 0x31, 0x30, 0x33, 0x20, 0x2f, 0x46, 0x69, 0x6c, 0x74, 0x65, 0x72, 0x20,
	0x2f, 0x46, 0x6c, 0x61, 0x74, 0x65, 0x44, 0x65, 0x63, 0x6f, 0x64, 0x65, 0x20, 0x3e, 0x3e, 0x0a,
	0x73, 0x74, 0x72, 0x65, 0x61, 0x6d, 0x0a, 0x78, 0x9c, 0x73, 0x0a, 0x51, 0xd0, 0x77, 0x33, 0x54,
	0x30, 0x34, 0x51, 0x08, 0x49, 0x53, 0x30, 0x32, 0x50, 0x30, 0x34, 0x35, 0x50, 0x08, 0x49, 0x51,
	0xd0, 0xf0, 0x48, 0xcd, 0xc9, 0xc9, 0x57, 0x88, 0x4a, 0x2d, 0xc8, 0xa8, 0x2c, 0xd2, 0x54, 0x08,
	0xc9, 0x52, 0x30, 0x50, 0xd0, 0x35, 0x02, 0x4b, 0x45, 0x6b, 0x04, 0x68, 0x2a, 0x98, 0x1a, 0x28,
	0x68, 0xb8, 0xb8, 0x69, 0x2a, 0xe8, 0x9a, 0x19, 0x18, 0x28, 0x68, 0x14, 0xa5, 0x26, 0xa6, 0xa4,
	0x16, 0x69, 0xc6, 0x2a, 0x84, 0x78, 0x21, 0xd4, 0x69, 0x14, 0xa7, 0x26, 0xe7, 0xe7, 0xa5, 0x28,
	0xe4, 0x64, 0xe6, 0xa5, 0x82, 0x4d, 0x70, 0x0d, 0x01, 0x00, 0xcf, 0x68, 0x1c, 0x29, 0x0a, 0x65,
	0x6e, 0x64, 0x73, 0x74, 0x72, 0x65, 0x61, 0x6d, 0x0a, 0x65, 0x6e, 0x64, 0x6f, 0x62, 0x6a, 0x0a,
	0x37, 0x20, 0x30, 0x20, 0x6f, 0x62, 0x6a, 0x0a, 0x3c, 0x3c, 0x20, 0x2f, 0x54, 0x79, 0x70, 0x65,
	0x20, 0x2f, 0x58, 0x52, 0x65, 0x66, 0x20, 0x2f, 0x53, 0x69, 0x7a, 0x65, 0x20, 0x38, 0x20, 0x2f,
	0x57, 0x20, 0x5b, 0x31, 0x20, 0x32, 0x20, 0x31, 0x5d, 0x20, 0x2f, 0x52, 0x6f, 0x6f, 0x74, 0x20,
	0x31, 0x20, 0x30, 0x20, 0x52, 0x20, 0x2f, 0x46, 0x69, 0x6c, 0x74, 0x65, 0x72, 0x20, 0x2f, 0x46,
	0x6c, 0x61, 0x74, 0x65, 0x44, 0x65, 0x63, 0x6f, 0x64, 0x65, 0x20, 0x2f, 0x44, 0x65, 0x63, 0x6f,
	0x64, 0x65, 0x50, 0x61, 0x72, 0x6d, 0x73, 0x20, 0x3c, 0x3c, 0x20, 0x2f, 0x50, 0x72, 0x65, 0x64,
	0x69, 0x63, 0x74, 0x6f, 0x72, 0x20, 0x31, 0x32, 0x20, 0x2f, 0x43, 0x6f, 0x6c, 0x75, 0x6d, 0x6e,
	0x73, 0x20, 0x34, 0x20, 0x3e, 0x3e, 0x20, 0x2f, 0x4c, 0x65, 0x6e, 0x67, 0x74, 0x68, 0x20, 0x34,
	0x32, 0x20, 0x3e, 0x3e, 0x0a, 0x73, 0x74, 0x72, 0x65, 0x61, 0x6d, 0x0a, 0x78, 0x9c, 0x2d, 0xc4,
	0xc1, 0x0d, 0x00, 0x10, 0x14, 0x05, 0xc1, 0xfd, 0x2b, 0x91, 0xa8, 0x4d, 0xbd, 0x0a, 0x53, 0x00,
	0xcf, 0xc5, 0x1c, 0x46, 0x20, 0x4a, 0x2f, 0x81, 0x5f, 0x6a, 0x5e, 0x2b, 0xab, 0x19, 0xc6, 0x11,
	0x37, 0x0f, 0x75, 0x42, 0x08, 0x14, 0x0a, 0x65, 0x6e, 0x64, 0x73, 0x74, 0x72, 0x65, 0x61, 0x6d,
	0x0a, 0x65, 0x6e, 0x64, 0x6f, 0x62, 0x6a, 0x0a, 0x73, 0x74, 0x61, 0x72, 0x74, 0x78, 0x72, 0x65,
	0x66, 0x0a, 0x35, 0x31, 0x32, 0x0a, 0x25, 0x25, 0x45, 0x4f, 0x46, 0x0a,
};
static const uint8_t pdf_broken_startxref[] = {
	0x25, 0x50, 0x44, 0x46, 0x2d, 0x31, 0x2e, 0x34, 0x0a, 0x25, 0xe2, 0xe3, 0xcf, 0xd3, 0x0a, 0x31,
	0x20, 0x30, 0x20, 0x6f, 0x62, 0x6a, 0x0a, 0x3c, 0x3c, 0x20, 0x2f, 0x54, 0x79, 0x70, 0x65, 0x20,
	0x2f, 0x43, 0x61, 0x74, 0x61, 0x6c, 0x6f, 0x67, 0x20, 0x2f, 0x50, 0x61, 0x67, 0x65, 0x73, 0x20,
	0x32, 0x20, 0x30, 0x20, 0x52, 0x20, 0x3e, 0x3e, 0x0a, 0x65, 0x6e, 0x64, 0x6f, 0x62, 0x6a, 0x0a,
	0x32, 0x20, 0x30, 0x20, 0x6f, 0x62, 0x6a, 0x0a, 0x3c, 0x3c, 0x20, 0x2f, 0x54, 0x79, 0x70, 0x65,
	0x20, 0x2f, 0x50, 0x61, 0x67, 0x65, 0x73, 0x20, 0x2f, 0x4b, 0x69, 0x64, 0x73, 0x20, 0x5b, 0x33,
	0x20, 0x30, 0x20, 0x52, 0x5d, 0x20, 0x2f, 0x43, 0x6f, 0x75, 0x6e, 0x74, 0x20, 0x31, 0x20, 0x3e,
	0x3e, 0x0a, 0x65, 0x6e, 0x64, 0x6f, 0x62, 0x6a, 0x0a, 0x33, 0x20, 0x30, 0x20, 0x6f, 0x62, 0x6a,
	0x0a, 0x3c, 0x3c, 0x20, 0x2f, 0x54, 0x79, 0x70, 0x65, 0x20, 0x2f, 0x50, 0x61, 0x67, 0x65, 0x20,
	0x2f, 0x50, 0x61, 0x72, 0x65, 0x6e, 0x74, 0x20, 0x32, 0x20, 0x30, 0x20, 0x52, 0x20, 0x2f, 0x4d,
	0x65, 0x64, 0x69, 0x61, 0x42, 0x6f, 0x78, 0x20, 0x5b, 0x30, 0x20, 0x30, 0x20, 0x33, 0x30, 0x30,
	0x20, 0x32, 0x30, 0x30, 0x5d, 0x20, 0x2f, 0x52, 0x65, 0x73, 0x6f, 0x75, 0x72, 0x63, 0x65, 0x73,
	0x20, 0x3c, 0x3c, 0x20, 0x2f, 0x46, 0x6f, 0x6e, 0x74, 0x20, 0x3c, 0x3c, 0x20, 0x2f, 0x46, 0x31,
	0x20, 0x35, 0x20, 0x30, 0x20, 0x52, 0x20, 0x3e, 0x3e, 0x20, 0x3e, 0x3e, 0x20, 0x2f, 0x43, 0x6f,
	0x6e, 0x74, 0x65, 0x6e, 0x74, 0x73, 0x20, 0x34, 0x20, 0x30, 0x20, 0x52, 0x20, 0x3e, 0x3e, 0x0a,
	0x65, 0x6e, 0x64, 0x6f, 0x62, 0x6a, 0x0a, 0x34, 0x20, 0x30, 0x20, 0x6f, 0x62, 0x6a, 0x0a, 0x3c,
	0x3c, 0x20, 0x2f, 0x4c, 0x65, 0x6e, 0x67, 0x74, 0x68, 0x20, 0x31, 0x30, 0x39, 0x20, 0x3e, 0x3e,
	0x0a, 0x73, 0x74, 0x72, 0x65, 0x61, 0x6d, 0x0a, 0x42, 0x54, 0x20, 0x2f, 0x46, 0x31, 0x20, 0x31,
	0x34, 0x20, 0x54, 0x66, 0x20, 0x32, 0x30, 0x20, 0x31, 0x35, 0x30, 0x20, 0x54, 0x64, 0x20, 0x28,
	0x48, 0x65, 0x6c, 0x6c, 0x6f, 0x20, 0x5a, 0x65, 0x70, 0x68, 0x79, 0x72, 0x29, 0x20, 0x54, 0x6a,
	0x20, 0x30, 0x20, 0x2d, 0x32, 0x30, 0x20, 0x54, 0x64, 0x20, 0x5b, 0x28, 0x50, 0x29, 0x20, 0x35,
	0x30, 0x20, 0x28, 0x44, 0x46, 0x29, 0x20, 0x2d, 0x36, 0x30, 0x30, 0x20, 0x28, 0x72, 0x65, 0x61,
	0x64, 0x65, 0x72, 0x29, 0x5d, 0x20, 0x54, 0x4a, 0x20, 0x30, 0x20, 0x2d, 0x32, 0x30, 0x20, 0x54,
	0x64, 0x20, 0x28, 0x73, 0x65, 0x63, 0x6f, 0x6e, 0x64, 0x20, 0x6c, 0x69, 0x6e, 0x65, 0x29, 0x20,
	0x54, 0x6a, 0x20, 0x45, 0x54, 0x0a, 0x65, 0x6e, 0x64, 0x73, 0x74, 0x72, 0x65, 0x61, 0x6d, 0x0a,
	0x65, 0x6e, 0x64, 0x6f, 0x62, 0x6a, 0x0a, 0x35, 0x20, 0x30, 0x20, 0x6f, 0x62, 0x6a, 0x0a, 0x3c,
	0x3c, 0x20, 0x2f, 0x54, 0x79, 0x70, 0x65, 0x20, 0x2f, 0x46, 0x6f, 0x6e, 0x74, 0x20, 0x2f, 0x53,
	0x75, 0x62, 0x74, 0x79, 0x70, 0x65, 0x20, 0x2f, 0x54, 0x79, 0x70, 0x65, 0x31, 0x20, 0x2f, 0x42,
	0x61, 0x73, 0x65, 0x46, 0x6f, 0x6e, 0x74, 0x20, 0x2f, 0x48, 0x65, 0x6c, 0x76, 0x65, 0x74, 0x69,
	0x63, 0x61, 0x20, 0x3e, 0x3e, 0x0a, 0x65, 0x6e, 0x64, 0x6f, 0x62, 0x6a, 0x0a, 0x78, 0x72, 0x65,
	0x66, 0x0a, 0x30, 0x20, 0x36, 0x0a, 0x30, 0x30, 0x30, 0x30, 0x30, 0x30, 0x30, 0x30, 0x30, 0x30,
	0x20, 0x36, 0x35, 0x35, 0x33, 0x35, 0x20, 0x66, 0x20, 0x0a, 0x30, 0x30, 0x30, 0x30, 0x30, 0x30,
	0x30, 0x30, 0x31, 0x35, 0x20, 0x30, 0x30, 0x30, 0x30, 0x30, 0x20, 0x6e, 0x20, 0x0a, 0x30, 0x30,
	0x30, 0x30, 0x30, 0x30, 0x30, 0x30, 0x36, 0x34, 0x20, 0x30, 0x30, 0x30, 0x30, 0x30, 0x20, 0x6e,
	0x20, 0x0a, 0x30, 0x30, 0x30, 0x30, 0x30, 0x30, 0x30, 0x31, 0x32, 0x31, 0x20, 0x30, 0x30, 0x30,
	0x30, 0x30, 0x20, 0x6e, 0x20, 0x0a, 0x30, 0x30, 0x30, 0x30, 0x30, 0x30, 0x30, 0x32, 0x34, 0x37,
	0x20, 0x30, 0x30, 0x30, 0x30, 0x30, 0x20, 0x6e, 0x20, 0x0a, 0x30, 0x30, 0x30, 0x30, 0x30, 0x30,
	0x30, 0x34, 0x30, 0x37, 0x20, 0x30, 0x30, 0x30, 0x30, 0x30, 0x20, 0x6e, 0x20, 0x0a, 0x74, 0x72,
	0x61, 0x69, 0x6c, 0x65, 0x72, 0x0a, 0x3c, 0x3c, 0x20, 0x2f, 0x53, 0x69, 0x7a, 0x65, 0x20, 0x36,
	0x20, 0x2f, 0x52, 0x6f, 0x6f, 0x74, 0x20, 0x31, 0x20, 0x30, 0x20, 0x52, 0x20, 0x3e, 0x3e, 0x0a,
	0x73, 0x74, 0x61, 0x72, 0x74, 0x78, 0x72, 0x65, 0x66, 0x0a, 0x39, 0x34, 0x37, 0x37, 0x0a, 0x25,
	0x25, 0x45, 0x4f, 0x46, 0x0a,
};
static const uint8_t pdf_truncated[] = {
	0x25, 0x50, 0x44, 0x46, 0x2d, 0x31, 0x2e, 0x34, 0x0a, 0x25, 0xe2, 0xe3, 0xcf, 0xd3, 0x0a, 0x31,
	0x20, 0x30, 0x20, 0x6f, 0x62, 0x6a, 0x0a, 0x3c, 0x3c, 0x20, 0x2f, 0x54, 0x79, 0x70, 0x65, 0x20,
	0x2f, 0x43, 0x61, 0x74, 0x61, 0x6c, 0x6f, 0x67, 0x20, 0x2f, 0x50, 0x61, 0x67, 0x65, 0x73, 0x20,
	0x32, 0x20, 0x30, 0x20, 0x52, 0x20, 0x3e, 0x3e, 0x0a, 0x65, 0x6e, 0x64, 0x6f, 0x62, 0x6a, 0x0a,
	0x32, 0x20, 0x30, 0x20, 0x6f, 0x62, 0x6a, 0x0a, 0x3c, 0x3c, 0x20, 0x2f, 0x54, 0x79, 0x70, 0x65,
	0x20, 0x2f, 0x50, 0x61, 0x67, 0x65, 0x73, 0x20, 0x2f, 0x4b, 0x69, 0x64, 0x73, 0x20, 0x5b, 0x33,
	0x20, 0x30, 0x20, 0x52, 0x5d, 0x20, 0x2f, 0x43, 0x6f, 0x75, 0x6e, 0x74, 0x20, 0x31, 0x20, 0x3e,
	0x3e, 0x0a, 0x65, 0x6e, 0x64, 0x6f, 0x62, 0x6a, 0x0a, 0x33, 0x20, 0x30, 0x20, 0x6f, 0x62, 0x6a,
	0x0a, 0x3c, 0x3c, 0x20, 0x2f, 0x54, 0x79, 0x70, 0x65, 0x20, 0x2f, 0x50, 0x61, 0x67, 0x65, 0x20,
	0x2f, 0x50, 0x61, 0x72, 0x65, 0x6e, 0x74, 0x20, 0x32, 0x20, 0x30, 0x20, 0x52, 0x20, 0x2f, 0x4d,
	0x65, 0x64, 0x69, 0x61, 0x42, 0x6f, 0x78, 0x20, 0x5b, 0x30, 0x20, 0x30, 0x20, 0x33, 0x30, 0x30,
	0x20, 0x32, 0x30, 0x30, 0x5d, 0x20, 0x2f, 0x52, 0x65, 0x73, 0x6f, 0x75, 0x72, 0x63, 0x65, 0x73,
	0x20, 0x3c, 0x3c, 0x20, 0x2f, 0x46, 0x6f, 0x6e, 0x74, 0x20, 0x3c, 0x3c, 0x20, 0x2f, 0x46, 0x31,
	0x20, 0x35, 0x20, 0x30, 0x20, 0x52, 0x20, 0x3e, 0x3e, 0x20, 0x3e, 0x3e, 0x20, 0x2f, 0x43, 0x6f,
	0x6e, 0x74, 0x65, 0x6e, 0x74, 0x73, 0x20, 0x34, 0x20, 0x30, 0x20, 0x52, 0x20, 0x3e, 0x3e, 0x0a,
	0x65, 0x6e, 0x64, 0x6f, 0x62, 0x6a, 0x0a, 0x34, 0x20, 0x30, 0x20, 0x6f, 0x62, 0x6a, 0x0a, 0x3c,
	0x3c, 0x20, 0x2f, 0x4c, 0x65, 0x6e, 0x67, 0x74, 0x68, 0x20, 0x31, 0x30, 0x39, 0x20, 0x3e, 0x3e,
	0x0a, 0x73, 0x74, 0x72, 0x65, 0x61, 0x6d, 0x0a, 0x42, 0x54, 0x20, 0x2f, 0x46, 0x31, 0x20, 0x31,
	0x34, 0x20, 0x54, 0x66, 0x20, 0x32, 0x30, 0x20, 0x31, 0x35, 0x30, 0x20, 0x54, 0x64, 0x20, 0x28,
	0x48, 0x65, 0x6c, 0x6c, 0x6f, 0x20, 0x5a, 0x65, 0x70, 0x68, 0x79, 0x72, 0x29, 0x20, 0x54, 0x6a,
	0x20, 0x30, 0x20, 0x2d, 0x32, 0x30, 0x20, 0x54, 0x64, 0x20, 0x5b, 0x28, 0x50, 0x29, 0x20, 0x35,
	0x30, 0x20, 0x28, 0x44, 0x46, 0x29, 0x20, 0x2d, 0x36, 0x30, 0x30, 0x20, 0x28, 0x72, 0x65, 0x61,
	0x64, 0x65, 0x72, 0x29, 0x5d, 0x20, 0x54, 0x4a, 0x20, 0x30, 0x20, 0x2d, 0x32, 0x30, 0x20, 0x54,
	0x64, 0x20, 0x28, 0x73, 0x65, 0x63, 0x6f, 0x6e, 0x64, 0x20, 0x6c, 0x69, 0x6e, 0x65, 0x29, 0x20,
	0x54, 0x6a, 0x20, 0x45, 0x54, 0x0a, 0x65, 0x6e, 0x64, 0x73, 0x74, 0x72, 0x65, 0x61, 0x6d, 0x0a,
	0x65, 0x6e, 0x64, 0x6f, 0x62, 0x6a, 0x0a, 0x35, 0x20, 0x30, 0x20, 0x6f, 0x62, 0x6a, 0x0a, 0x3c,
	0x3c, 0x20, 0x2f, 0x54, 0x79, 0x70, 0x65, 0x20, 0x2f, 0x46, 0x6f, 0x6e, 0x74, 0x20, 0x2f, 0x53,
	0x75, 0x62, 0x74, 0x79, 0x70, 0x65, 0x20, 0x2f, 0x54, 0x79, 0x70, 0x65, 0x31, 0x20, 0x2f, 0x42,
	0x61, 0x73, 0x65, 0x46, 0x6f, 0x6e, 0x74, 0x20, 0x2f, 0x48, 0x65, 0x6c, 0x76, 0x65, 0x74, 0x69,
	0x63, 0x61, 0x20, 0x3e, 0x3e, 0x0a, 0x65, 0x6e, 0x64, 0x6f, 0x62, 0x6a, 0x0a, 0x78, 0x72, 0x65,
	0x66, 0x0a, 0x30, 0x20, 0x36, 0x0a, 0x30, 0x30, 0x30, 0x30, 0x30, 0x30, 0x30, 0x30, 0x30, 0x30,
	0x20, 0x36, 0x35, 0x35, 0x33, 0x35, 0x20, 0x66, 0x20, 0x0a, 0x30, 0x30, 0x30, 0x30, 0x30, 0x30,
	0x30, 0x30, 0x31, 0x35, 0x20, 0x30, 0x30, 0x30, 0x30, 0x30, 0x20, 0x6e, 0x20, 0x0a, 0x30, 0x30,
	0x30, 0x30, 0x30, 0x30, 0x30, 0x30, 0x36, 0x34, 0x20, 0x30, 0x30, 0x30, 0x30, 0x30, 0x20, 0x6e,
	0x20, 0x0a, 0x30, 0x30, 0x30, 0x30, 0x30, 0x30, 0x30, 0x31, 0x32, 0x31, 0x20, 0x30, 0x30, 0x30,
	0x30, 0x30, 0x20, 0x6e, 0x20, 0x0a, 0x30, 0x30, 0x30, 0x30, 0x30, 0x30, 0x30, 0x32, 0x34, 0x37,
	0x20, 0x30, 0x30, 0x30, 0x30, 0x30, 0x20, 0x6e, 0x20, 0x0a, 0x30, 0x30, 0x30, 0x30, 0x30, 0x30,
	0x30, 0x34, 0x30, 0x37, 0x20, 0x30, 0x30, 0x30, 0x30, 0x30, 0x20, 0x6e, 0x20, 0x0a, 0x74, 0x72,
	0x61, 0x69, 0x6c, 0x65, 0x72, 0x0a, 0x3c, 0x3c, 0x20, 0x2f, 0x53, 0x69, 0x7a, 0x65, 0x20, 0x36,
	0x20, 0x2f, 0x52, 0x6f, 0x6f, 0x74, 0x20, 0x31, 0x20, 0x30, 0x20, 0x52, 0x20, 0x3e, 0x3e, 0x0a,
};
static const uint8_t pdf_type0[] = {
	0x25, 0x50, 0x44, 0x46, 0x2d, 0x31, 0x2e, 0x34, 0x0a, 0x31, 0x20, 0x30, 0x20, 0x6f, 0x62, 0x6a,
	0x0a, 0x3c, 0x3c, 0x20, 0x2f, 0x54, 0x79, 0x70, 0x65, 0x20, 0x2f, 0x43, 0x61, 0x74, 0x61, 0x6c,
	0x6f, 0x67, 0x20, 0x2f, 0x50, 0x61, 0x67, 0x65, 0x73, 0x20, 0x32, 0x20, 0x30, 0x20, 0x52, 0x20,
	0x3e, 0x3e, 0x0a, 0x65, 0x6e, 0x64, 0x6f, 0x62, 0x6a, 0x0a, 0x32, 0x20, 0x30, 0x20, 0x6f, 0x62,
	0x6a, 0x0a, 0x3c, 0x3c, 0x20, 0x2f, 0x54, 0x79, 0x70, 0x65, 0x20, 0x2f, 0x50, 0x61, 0x67, 0x65,
	0x73, 0x20, 0x2f, 0x4b, 0x69, 0x64, 0x73, 0x20, 0x5b, 0x33, 0x20, 0x30, 0x20, 0x52, 0x5d, 0x20,
	0x2f, 0x43, 0x6f, 0x75, 0x6e, 0x74, 0x20, 0x31, 0x20, 0x3e, 0x3e, 0x0a, 0x65, 0x6e, 0x64, 0x6f,
	0x62, 0x6a, 0x0a, 0x33, 0x20, 0x30, 0x20, 0x6f, 0x62, 0x6a, 0x0a, 0x3c, 0x3c, 0x20, 0x2f, 0x54,
	0x79, 0x70, 0x65, 0x20, 0x2f, 0x50, 0x61, 0x67, 0x65, 0x20, 0x2f, 0x50, 0x61, 0x72, 0x65, 0x6e,
	0x74, 0x20, 0x32, 0x20, 0x30, 0x20, 0x52, 0x20, 0x2f, 0x4d, 0x65, 0x64, 0x69, 0x61, 0x42, 0x6f,
	0x78, 0x20, 0x5b, 0x30, 0x20, 0x30, 0x20, 0x33, 0x30, 0x30, 0x20, 0x32, 0x30, 0x30, 0x5d, 0x20,
	0x2f, 0x52, 0x65, 0x73, 0x6f, 0x75, 0x72, 0x63, 0x65, 0x73, 0x20, 0x3c, 0x3c, 0x20, 0x2f, 0x46,
	0x6f, 0x6e, 0x74, 0x20, 0x3c, 0x3c, 0x20, 0x2f, 0x46, 0x31, 0x20, 0x35, 0x20, 0x30, 0x20, 0x52,
	0x20, 0x3e, 0x3e, 0x20, 0x3e, 0x3e, 0x20, 0x2f, 0x43, 0x6f, 0x6e, 0x74, 0x65, 0x6e, 0x74, 0x73,
	0x20, 0x34, 0x20, 0x30, 0x20, 0x52, 0x20, 0x3e, 0x3e, 0x0a, 0x65, 0x6e, 0x64, 0x6f, 0x62, 0x6a,
	0x0a, 0x34, 0x20, 0x30, 0x20, 0x6f, 0x62, 0x6a, 0x0a, 0x3c, 0x3c, 0x20, 0x2f, 0x4c, 0x65, 0x6e,
	0x67, 0x74, 0x68, 0x20, 0x35, 0x31, 0x20, 0x3e, 0x3e, 0x0a, 0x73, 0x74, 0x72, 0x65, 0x61, 0x6d,
	0x0a, 0x42, 0x54, 0x20, 0x2f, 0x46, 0x31, 0x20, 0x31, 0x32, 0x20, 0x54, 0x66, 0x20, 0x32, 0x30,
	0x20, 0x31, 0x30, 0x30, 0x20, 0x54, 0x64, 0x20, 0x3c, 0x30, 0x30, 0x30, 0x31, 0x30, 0x30, 0x30,
	0x32, 0x30, 0x30, 0x30, 0x33, 0x30, 0x30, 0x30, 0x34, 0x30, 0x30, 0x30, 0x35, 0x3e, 0x20, 0x54,
	0x6a, 0x20, 0x45, 0x54, 0x0a, 0x65, 0x6e, 0x64, 0x73, 0x74, 0x72, 0x65, 0x61, 0x6d, 0x0a, 0x65,
	0x6e, 0x64, 0x6f, 0x62, 0x6a, 0x0a, 0x35, 0x20, 0x30, 0x20, 0x6f, 0x62, 0x6a, 0x0a, 0x3c, 0x3c,
	0x20, 0x2f, 0x54, 0x79, 0x70, 0x65, 0x20, 0x2f, 0x46, 0x6f, 0x6e, 0x74, 0x20, 0x2f, 0x53, 0x75,
	0x62, 0x74, 0x79, 0x70, 0x65, 0x20, 0x2f, 0x54, 0x79, 0x70, 0x65, 0x30, 0x20, 0x2f, 0x42, 0x61,
	0x73, 0x65, 0x46, 0x6f, 0x6e, 0x74, 0x20, 0x2f, 0x54, 0x65, 0x73, 0x74, 0x20, 0x2f, 0x45, 0x6e,
	0x63, 0x6f, 0x64, 0x69, 0x6e, 0x67, 0x20, 0x2f, 0x49, 0x64, 0x65, 0x6e, 0x74, 0x69, 0x74, 0x79,
	0x2d, 0x48, 0x20, 0x2f, 0x44, 0x65, 0x73, 0x63, 0x65, 0x6e, 0x64, 0x61, 0x6e, 0x74, 0x46, 0x6f,
	0x6e, 0x74, 0x73, 0x20, 0x5b, 0x36, 0x20, 0x30, 0x20, 0x52, 0x5d, 0x20, 0x2f, 0x54, 0x6f, 0x55,
	0x6e, 0x69, 0x63, 0x6f, 0x64, 0x65, 0x20, 0x37, 0x20, 0x30, 0x20, 0x52, 0x20, 0x3e, 0x3e, 0x0a,
	0x65, 0x6e, 0x64, 0x6f, 0x62, 0x6a, 0x0a, 0x36, 0x20, 0x30, 0x20, 0x6f, 0x62, 0x6a, 0x0a, 0x3c,
	0x3c, 0x20, 0x2f, 0x54, 0x79, 0x70, 0x65, 0x20, 0x2f, 0x46, 0x6f, 0x6e, 0x74, 0x20, 0x2f, 0x53,
	0x75, 0x62, 0x74, 0x79, 0x70, 0x65, 0x20, 0x2f, 0x43, 0x49, 0x44, 0x46, 0x6f, 0x6e, 0x74, 0x54,
	0x79, 0x70, 0x65, 0x32, 0x20, 0x2f, 0x42, 0x61, 0x73, 0x65, 0x46, 0x6f, 0x6e, 0x74, 0x20, 0x2f,
	0x54, 0x65, 0x73, 0x74, 0x20, 0x2f, 0x43, 0x49, 0x44, 0x53, 0x79, 0x73, 0x74, 0x65, 0x6d, 0x49,
	0x6e, 0x66, 0x6f, 0x20, 0x3c, 0x3c, 0x20, 0x2f, 0x52, 0x65, 0x67, 0x69, 0x73, 0x74, 0x72, 0x79,
	0x20, 0x28, 0x41, 0x64, 0x6f, 0x62, 0x65, 0x29, 0x20, 0x2f, 0x4f, 0x72, 0x64, 0x65, 0x72, 0x69,
	0x6e, 0x67, 0x20, 0x28, 0x49, 0x64, 0x65, 0x6e, 0x74, 0x69, 0x74, 0x79, 0x29, 0x20, 0x2f, 0x53,
	0x75, 0x70, 0x70, 0x6c, 0x65, 0x6d, 0x65, 0x6e, 0x74, 0x20, 0x30, 0x20, 0x3e, 0x3e, 0x20, 0x2f,
	0x44, 0x57, 0x20, 0x36, 0x30, 0x30, 0x20, 0x2f, 0x57, 0x20, 0x5b, 0x31, 0x20, 0x5b, 0x37, 0x30,
	0x30, 0x20, 0x35, 0x30, 0x30, 0x5d, 0x20, 0x33, 0x20, 0x35, 0x20, 0x34, 0x30, 0x30, 0x5d, 0x20,
	0x3e, 0x3e, 0x0a, 0x65, 0x6e, 0x64, 0x6f, 0x62, 0x6a, 0x0a, 0x37, 0x20, 0x30, 0x20, 0x6f, 0x62,
	0x6a, 0x0a, 0x3c, 0x3c, 0x20, 0x2f, 0x4c, 0x65, 0x6e, 0x67, 0x74, 0x68, 0x20, 0x32, 0x36, 0x31,
	0x20, 0x3e, 0x3e, 0x0a, 0x73, 0x74, 0x72, 0x65, 0x61, 0x6d, 0x0a, 0x2f, 0x43, 0x49, 0x44, 0x49,
	0x6e, 0x69, 0x74, 0x20, 0x2f, 0x50, 0x72, 0x6f, 0x63, 0x53, 0x65, 0x74, 0x20, 0x66, 0x69, 0x6e,
	0x64, 0x72, 0x65, 0x73, 0x6f, 0x75, 0x72, 0x63, 0x65, 0x20, 0x62, 0x65, 0x67, 0x69, 0x6e, 0x20,
	0x62, 0x65, 0x67, 0x69, 0x6e, 0x63, 0x6d, 0x61, 0x70, 0x0a, 0x31, 0x20, 0x62, 0x65, 0x67, 0x69,
	0x6e, 0x63, 0x6f, 0x64, 0x65, 0x73, 0x70, 0x61, 0x63, 0x65, 0x72, 0x61, 0x6e, 0x67, 0x65, 0x20,
	0x3c, 0x30, 0x30, 0x30, 0x30, 0x3e, 0x20, 0x3c, 0x46, 0x46, 0x46, 0x46, 0x3e, 0x20, 0x65, 0x6e,
	0x64, 0x63, 0x6f, 0x64, 0x65, 0x73, 0x70, 0x61, 0x63, 0x65, 0x72, 0x61, 0x6e, 0x67, 0x65, 0x0a,
	0x32, 0x20, 0x62, 0x65, 0x67, 0x69, 0x6e, 0x62, 0x66, 0x63, 0x68, 0x61, 0x72, 0x20, 0x3c, 0x30,
	0x30, 0x30, 0x31, 0x3e, 0x20, 0x3c, 0x30, 0x30, 0x35, 0x41, 0x3e, 0x20, 0x3c, 0x30, 0x30, 0x30,
	0x35, 0x3e, 0x20, 0x3c, 0x46, 0x42, 0x30, 0x31, 0x3e, 0x20, 0x65, 0x6e, 0x64, 0x62, 0x66, 0x63,
	0x68, 0x61, 0x72, 0x0a, 0x31, 0x20, 0x62, 0x65, 0x67, 0x69, 0x6e, 0x62, 0x66, 0x72, 0x61, 0x6e,
	0x67, 0x65, 0x20, 0x3c, 0x30, 0x30, 0x30, 0x32, 0x3e, 0x20, 0x3c, 0x30, 0x30, 0x30, 0x34, 0x3e,
	0x20, 0x3c, 0x30, 0x30, 0x36, 0x35, 0x3e, 0x20, 0x65, 0x6e, 0x64, 0x62, 0x66, 0x72, 0x61, 0x6e,
	0x67, 0x65, 0x0a, 0x65, 0x6e, 0x64, 0x63, 0x6d, 0x61, 0x70, 0x20, 0x43, 0x4d, 0x61, 0x70, 0x4e,
	0x61, 0x6d, 0x65, 0x20, 0x63, 0x75, 0x72, 0x72, 0x65, 0x6e, 0x74, 0x64, 0x69, 0x63, 0x74, 0x20,
	0x2f, 0x43, 0x4d, 0x61, 0x70, 0x20, 0x64, 0x65, 0x66, 0x69, 0x6e, 0x65, 0x72, 0x65, 0x73, 0x6f,
	0x75, 0x72, 0x63, 0x65, 0x20, 0x70, 0x6f, 0x70, 0x20, 0x65, 0x6e, 0x64, 0x20, 0x65, 0x6e, 0x64,
	0x0a, 0x65, 0x6e, 0x64, 0x73, 0x74, 0x72, 0x65, 0x61, 0x6d, 0x0a, 0x65, 0x6e, 0x64, 0x6f, 0x62,
	0x6a, 0x0a, 0x78, 0x72, 0x65, 0x66, 0x0a, 0x30, 0x20, 0x38, 0x0a, 0x30, 0x30, 0x30, 0x30, 0x30,
	0x30, 0x30, 0x30, 0x30, 0x30, 0x20, 0x36, 0x35, 0x35, 0x33, 0x35, 0x20, 0x66, 0x20, 0x0a, 0x30,
	0x30, 0x30, 0x30, 0x30, 0x30, 0x30, 0x30, 0x30, 0x39, 0x20, 0x30, 0x30, 0x30, 0x30, 0x30, 0x20,
	0x6e, 0x20, 0x0a, 0x30, 0x30, 0x30, 0x30, 0x30, 0x30, 0x30, 0x30, 0x35, 0x38, 0x20, 0x30, 0x30,
	0x30, 0x30, 0x30, 0x20, 0x6e, 0x20, 0x0a, 0x30, 0x30, 0x30, 0x30, 0x30, 0x30, 0x30, 0x31, 0x31,
	0x35, 0x20, 0x30, 0x30, 0x30, 0x30, 0x30, 0x20, 0x6e, 0x20, 0x0a, 0x30, 0x30, 0x30, 0x30, 0x30,
	0x30, 0x30, 0x32, 0x34, 0x31, 0x20, 0x30, 0x30, 0x30, 0x30, 0x30, 0x20, 0x6e, 0x20, 0x0a, 0x30,
	0x30, 0x30, 0x30, 0x30, 0x30, 0x30, 0x33, 0x34, 0x32, 0x20, 0x30, 0x30, 0x30, 0x30, 0x30, 0x20,
	0x6e, 0x20, 0x0a, 0x30, 0x30, 0x30, 0x30, 0x30, 0x30, 0x30, 0x34, 0x37, 0x31, 0x20, 0x30, 0x30,
	0x30, 0x30, 0x30, 0x20, 0x6e, 0x20, 0x0a, 0x30, 0x30, 0x30, 0x30, 0x30, 0x30, 0x30, 0x36, 0x35,
	0x30, 0x20, 0x30, 0x30, 0x30, 0x30, 0x30, 0x20, 0x6e, 0x20, 0x0a, 0x74, 0x72, 0x61, 0x69, 0x6c,
	0x65, 0x72, 0x0a, 0x3c, 0x3c, 0x20, 0x2f, 0x53, 0x69, 0x7a, 0x65, 0x20, 0x38, 0x20, 0x2f, 0x52,
	0x6f, 0x6f, 0x74, 0x20, 0x31, 0x20, 0x30, 0x20, 0x52, 0x20, 0x3e, 0x3e, 0x0a, 0x73, 0x74, 0x61,
	0x72, 0x74, 0x78, 0x72, 0x65, 0x66, 0x0a, 0x39, 0x36, 0x32, 0x0a, 0x25, 0x25, 0x45, 0x4f, 0x46,
	0x0a,
};
```
